## Kconfig
```kconfig
mainmenu "hvisor UEFI Boot Image Packer Configuration Menu"

# config the target arch as the first choice
choice
  prompt "Target Architecture"
  default TARGET_ARCH_LOONGARCH64

config TARGET_ARCH_LOONGARCH64
  bool "loongarch64"
  help
    Select this option if you are building for LoongArch64.

config TARGET_ARCH_AARCH64
  bool "aarch64"
  help
    Select this option if you are building for AArch64.

config TARGET_ARCH_RISCV64
  bool "riscv64"
  help
    Select this option if you are building for RISCV64.

endchoice

menu "Build Configuration"
  config CROSS_COMPILE
    string "Cross compiler prefix"
    default "loongarch64-unknown-linux-gnu-"
    help
      Prefix for the cross compiler.
endmenu

menu "Binary Files"
  # Optional hvisor configuration
  config ENABLE_HVISOR_BIN
    bool "Enable hvisor.bin embedding"
    default n
    help
      Enable this option to embed vmlinux.bin in the boot image.

  config EMBEDDED_HVISOR_BIN_PATH
    string "Path to the embedded hvisor.bin (binary striped from ELF)"
    depends on ENABLE_HVISOR_BIN
    default "hvisor.bin"
    help
      Path to the embedded hvisor.bin file. Don't use any u-boot image binary here. Just use the raw "binary" file stripped from ELF.

  config HVISOR_BIN_LOAD_ADDR
    hex "hvisor.bin load address"
    depends on ENABLE_HVISOR_BIN
    default 0x90000000
    help
      Load address for hvisor.bin in memory.

  # Optional vmlinux configuration
  config ENABLE_VMLINUX
    bool "Enable vmlinux.bin embedding"
    default n
    help
      Enable this option to embed vmlinux.bin in the boot image.

  config EMBEDDED_VMLINUX_PATH
    string "Path to the embedded vmlinux.bin"
    depends on ENABLE_VMLINUX
    help
      Path to the embedded vmlinux.bin file.

  config VMLINUX_LOAD_ADDR
    hex "vmlinux.bin load address"
    depends on ENABLE_VMLINUX
    default 0x80000000
    help
      Load address for vmlinux.bin in memory.

  config ENABLE_DTB
    bool "Enable dtb embedding"
    default n
    help
      Enable this option to embed dtb in the boot image.

  config EMBEDDED_DTB_PATH
    string "Path to the embedded dtb"
    depends on ENABLE_DTB
    help
      Path to the embedded dtb file.

  config DTB_LOAD_ADDR
    hex "dtb load address"
    depends on ENABLE_DTB
    default 0x00000000
    help
      Load address for dtb in memory.

  config ENABLE_INITRD
    bool "Enable initrd embedding"
    default n
    help
      Enable this option to embed initrd in the boot image.

  config EMBEDDED_INITRD_PATH
    string "Path to the embedded initrd"
    depends on ENABLE_INITRD
    help
      Path to the embedded initrd file.

  config INITRD_LOAD_ADDR
    hex "initrd load address"
    depends on ENABLE_INITRD
    default 0x00000000
    help
      Load address for initrd in memory.
  
endmenu

menu "Source Directories"
  config HVISOR_SRC_DIR
    string "Path to hvisor source code directory"
    default "../hvisor"
    help
      Path to the hvisor source code directory.

  # Optional hvisor-la64-linux configuration
  config ENABLE_HVISOR_LA64_LINUX
    bool "Enable hvisor-la64-linux integration"
    default n
    help
      Enable this option to include hvisor-la64-linux kernel source.

  config HVISOR_LA64_LINUX_DIR
    string "Path to hvisor-la64-linux directory"
    depends on ENABLE_HVISOR_LA64_LINUX
    help
      Path to the hvisor-la64-linux directory containing Linux kernel source.

  # Optional buildroot configuration
  config ENABLE_BUILDROOT
    bool "Enable buildroot-loongarch64 integration"
    default n
    help
      Enable this option to include buildroot-loongarch64.

  config BUILDROOT_DIR
    string "Path to buildroot-loongarch64 directory"
    depends on ENABLE_BUILDROOT
    help
      Path to the buildroot-loongarch64 directory.

  # Optional hvisor-tool configuration
  config ENABLE_HVISOR_TOOL
    bool "Enable hvisor-tool integration"
    default n
    help
      Enable this option to include hvisor-tool.

  config HVISOR_TOOL_DIR
    string "Path to hvisor-tool directory"
    depends on ENABLE_HVISOR_TOOL
    help
      Path to the hvisor-tool directory.
endmenu

menu "Runtime Configuration"
  config ENABLE_SERIAL
    bool "Enable hv-boot output by mmio serial"
    default n
    help
      Some board have mmio protect in UEFI. If you trouble in memory access problem, try to disable it.

  config DIRECT_BOOT_LINUX
    bool "Boot linux dirctly by hv-boot"
    depends on ENABLE_VMLINUX
    default n
    help
      Do not boot hvisor, boot linux directly.

  config UEFI_RT_SERVICE_SUPPORT
    bool "Support UEFI runtime service"
    default n
    help
      In order to use UEFI runtime service, hv-boot needs to prepare something.

  config FAKE_SYSTEM_TABLE_ADDR
    hex "Fake system table address"
    depends on UEFI_RT_SERVICE_SUPPORT
    default 0xB0000000
    help
      Copy address for system table in memory.

  config HVISOR_LOG_LEVEL
    string "Hvisor log level (optional)"
    default "info"
    help
      Set the log level for hvisor (error, warn, info, debug, trace). Leave default if not needed.


endmenu

# Validation rules
config HVISOR_SRC_DIR_VALIDATION
  bool
  default y
  depends on HVISOR_SRC_DIR != ""
  help
    Validation: hvisor source directory must be specified.

config EMBEDDED_HVISOR_BIN_PATH_VALIDATION
  bool
  default y
  depends on EMBEDDED_HVISOR_BIN_PATH != ""
  help
    Validation: hvisor binary path must be specified.

config VMLINUX_PATH_VALIDATION
  bool
  default y
  depends on !ENABLE_VMLINUX || (ENABLE_VMLINUX && EMBEDDED_VMLINUX_PATH != "")
  help
    Validation: vmlinux path must be specified when vmlinux is enabled.

config LA64_LINUX_DIR_VALIDATION
  bool
  default y
  depends on !ENABLE_HVISOR_LA64_LINUX || (ENABLE_HVISOR_LA64_LINUX && HVISOR_LA64_LINUX_DIR != "")
  help
    Validation: hvisor-la64-linux directory must be specified when enabled.

config BUILDROOT_DIR_VALIDATION
  bool
  default y
  depends on !ENABLE_BUILDROOT || (ENABLE_BUILDROOT && BUILDROOT_DIR != "")
  help
    Validation: buildroot directory must be specified when enabled.

config HVISOR_TOOL_DIR_VALIDATION
  bool
  default y
  depends on !ENABLE_HVISOR_TOOL || (ENABLE_HVISOR_TOOL && HVISOR_TOOL_DIR != "")
  help
    Validation: hvisor-tool directory must be specified when enabled.
```
